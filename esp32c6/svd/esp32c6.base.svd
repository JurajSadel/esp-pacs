# ESP32-C6 register map
Vendor: ESPRESSIF SYSTEMS (SHANGHAI) CO., LTD.; Series: ESP32 C-Series; File version: 2
32-bit RISC-V MCU & 2.4 GHz Wi-Fi 6 & Bluetooth 5 (LE) & IEEE 802.15.4
CPU: RV32IMC r0p0, little endian, no MPU, no FPU, 4 interrupt priority bits
Address unit: 32 bits
Registers are 32-bit, read-write, reset 0x0 unless marked. A register's access mark holds for its fields unless they carry their own. Offsets are from the block's base; lines under a group give offsets from that group; [hi:lo] are bit positions; {n}, {i} and the like mark numbered series; 'fields as' and 'values as' point back to an identical list; <NAME> marks a mode.

## Memory map
0x60000000 UART0 size 0x98 — UART (Universal Asynchronous Receiver-Transmitter) Controller
0x60001000 UART1 size 0x98 — UART (Universal Asynchronous Receiver-Transmitter) Controller
0x60002000 SPI0 size 0x138 — SPI (Serial Peripheral Interface) Controller
0x60003000 SPI1 size 0xAC — SPI (Serial Peripheral Interface) Controller
0x60004000 I2C0 size 0x90 — I2C (Inter-Integrated Circuit) Controller
0x60004F00 GPIOSD size 0x7C — Sigma-Delta Modulation
0x60005000 UHCI0 size 0x84 — Universal Host Controller Interface
0x60006000 RMT size 0x78 — Remote Control Peripheral
0x60007000 LEDC size 0x154 — LED Control PWM (Pulse Width Modulation)
0x60008000 TIMG0 size 0x68 — Timer Group
0x60009000 TIMG1 size 0x68 — Timer Group
0x6000A000 SYSTIMER size 0x90 — System Timer
0x6000B000 TWAI0 size 0x80 — Two-Wire Automotive Interface
0x6000C000 I2S0 size 0x60 — I2S (Inter-IC Sound) Controller
0x6000D000 TWAI1 size 0x80 — Two-Wire Automotive Interface
0x6000E000 APB_SARADC size 0x70 — Successive Approximation Register Analog to Digital Converter
0x6000F000 USB_DEVICE size 0x70 — Full-speed USB Serial/JTAG Controller
0x60010000 INTERRUPT_CORE0 size 0x148 — Interrupt Core
0x60011000 ATOMIC size 0x14 — Atomic Locker
0x60012000 PCNT size 0x68 — Pulse Counter
0x60013000 SOC_ETM size 0x1B0 — Peripheral SOC_ETM
0x60014000 MCPWM size 0x130 — Motor Control Pulse-Width Modulation
0x60015000 PARL_IO size 0x2C — Peripheral PARL_IO
0x60016000 HINF size 0x54 — Peripheral HINF
0x60017000 SLCHOST size 0x104 — Peripheral SLCHOST
0x60080000 DMA size 0x1A4 — DMA (Direct Memory Access) Controller
0x60081000 SPI2 size 0x98 — SPI (Serial Peripheral Interface) Controller
0x60088000 AES size 0xBC — AES (Advanced Encryption Standard) Accelerator
0x60089000 SHA size 0xB0 — SHA (Secure Hash Algorithm) Accelerator
0x6008A000 RSA size 0x74 — RSA (Rivest Shamir Adleman) Accelerator
0x6008B000 ECC size 0x78 — ECC (ECC Hardware Accelerator)
0x6008C000 DS size 0xA5C — Digital Signature
0x6008D000 HMAC size 0xA4 — HMAC (Hash-based Message Authentication Code) Accelerator
0x60090000 IO_MUX size 0x88 — Input/Output Multiplexer
0x60091000 GPIO size 0x39C — General Purpose Input/Output
0x60092000 MEM_MONITOR size 0x30 — Peripheral MEM_MONITOR
0x60093000 PAU size 0x4C — Peripheral PAU
0x60095000 HP_SYS size 0x5C — High-Power System
0x60096000 PCR size 0x14C — Peripheral PCR
0x60098000 TEE size 0x88 — Peripheral TEE
0x60099000 HP_APM size 0x114 — Peripheral HP_APM
0x60099800 LP_APM0 size 0x54 — Peripheral LP_APM0
0x600B0000 PMU size 0x1A8 — Peripheral PMU
0x600B0400 LP_CLKRST size 0x34 — Peripheral LP_CLKRST
0x600B0800 EFUSE size 0x1D0 — eFuse Controller
0x600B0C00 LP_TIMER size 0x4C — Peripheral LP_TIMER
0x600B1000 LP_AON size 0x5C — Peripheral LP_AON
0x600B1400 LP_UART size 0x84 — Peripheral LP_UART
0x600B1800 LP_I2C0 size 0x88 — Peripheral LP_I2C0
0x600B1C00 LP_WDT size 0x38 — Peripheral LP_WDT
0x600B2000 LP_IO size 0x7C — Peripheral LP_IO
0x600B2400 LP_I2C_ANA_MST size 0x1C — Peripheral LP_I2C_ANA_MST
0x600B2800 LP_PERI size 0x28 — Peripheral LP_PERI
0x600B2800 RNG size 0x4 — Hardware random number generator
0x600B2C00 LP_ANA size 0x34 — Peripheral LP_ANA
0x600B3400 LP_TEE size 0x10 — Peripheral LP_TEE
0x600B3800 LP_APM size 0x64 — Peripheral LP_APM
0x600B3C00 OTP_DEBUG size 0x210 — Peripheral OTP_DEBUG
0x600C0000 TRACE size 0x30 — Peripheral TRACE
0x600C2000 ASSIST_DEBUG size 0x80 — Debug Assist
0x600C5000 INTPRI size 0xB8 — Peripheral INTPRI
0x600C8000 EXTMEM size 0x3C8 — External Memory

## Interrupts
0 WIFI_MAC (INTERRUPT_CORE0)
1 WIFI_MAC_NMI (INTERRUPT_CORE0)
2 WIFI_PWR (INTERRUPT_CORE0)
3 WIFI_BB (INTERRUPT_CORE0)
4 BT_MAC (INTERRUPT_CORE0)
5 BT_BB (INTERRUPT_CORE0)
6 BT_BB_NMI (INTERRUPT_CORE0)
7 LP_TIMER (INTERRUPT_CORE0)
8 COEX (INTERRUPT_CORE0)
9 BLE_TIMER (INTERRUPT_CORE0)
10 BLE_SEC (INTERRUPT_CORE0)
13 PMU
14 EFUSE
16 LP_UART
17 LP_I2C (LP_I2C0)
19 LP_PERI_TIMEOUT (LP_PERI)
20 LP_APM_M0 (LP_APM)
21 LP_APM_M1 (LP_APM)
26 ASSIST_DEBUG
27 TRACE
30 GPIO_PRO (GPIO)
31 GPIO_PRO_NMI (GPIO)
32 PAU
35 HP_APM_M0 (HP_APM)
36 HP_APM_M1 (HP_APM)
37 HP_APM_M2 (HP_APM)
38 HP_APM_M3 (HP_APM)
39 LP_APM0 (LP_APM)
41 I2S1 (I2S0)
42 UHCI0
43 UART0
44 UART1
45 LEDC
46 TWAI0
47 TWAI1
48 USB (USB_DEVICE)
49 RMT
50 I2C_EXT0 (I2C0)
51 TG0_T0 (TIMG0)
52 TG0_T1 (TIMG0)
53 TG0_WDT (TIMG0)
54 TG1_T0 (TIMG1)
55 TG1_T1 (TIMG1)
56 TG1_WDT (TIMG1)
57 SYSTIMER_TARGET0 (SYSTIMER)
58 SYSTIMER_TARGET1 (SYSTIMER)
59 SYSTIMER_TARGET2 (SYSTIMER)
60 APB_SARADC
61 PWM (MCPWM)
62 PCNT
63 PARL_IO
66 DMA_IN_CH0 (DMA)
67 DMA_IN_CH1 (DMA)
68 DMA_IN_CH2 (DMA)
69 DMA_OUT_CH0 (DMA)
70 DMA_OUT_CH1 (DMA)
71 DMA_OUT_CH2 (DMA)
72 SPI2
73 AES
74 SHA
75 RSA
76 ECC

## Licence text in the file
Copyright 2023 Espressif Systems (Shanghai) PTE LTD Licensed under the Apache License, Version 2.0 (the "License"); you may not use this file except in compliance with the License. You may obtain a copy of the License at http://www.apache.org/licenses/LICENSE-2.0 Unless required by applicable law or agreed to in writing, software distributed under the License is distributed on an "AS IS" BASIS, WITHOUT WARRANTIES OR CONDITIONS OF ANY KIND, either express or implied. See the License for the specific language governing permissions and limitations under the License.
